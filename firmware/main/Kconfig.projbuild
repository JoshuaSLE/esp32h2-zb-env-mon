## firmware/main/Kconfig.projbuild
```kconfig
menu "Application Configuration"

    menu "Input"
        config APP_INPUT_RST_GPIO
            int "Reset button GPIO number"
            range 0 27
            default 12
            help
                GPIO wired to the physical reset/pairing button. Short press
                triggers Zigbee Identify; long press (see firmware) triggers
                a factory reset / leave-network action.

        config APP_INPUT_DISP_BTN_GPIO
            int "Display button GPIO number"
            range 0 27
            default 22
            help
                GPIO wired to the push button for waking the display and
                cycling through display timeouts.
    endmenu

    menu "I2C Bus"
        config APP_I2C_SDA_GPIO
            int "I2C SDA GPIO number"
            range 0 27
            default 10
            help
                GPIO used for I2C SDA line.

        config APP_I2C_SCL_GPIO
            int "I2C SCL GPIO number"
            range 0 27
            default 11
            help
                GPIO used for I2C SCL line.

        config APP_I2C_FREQ_HZ
            int "I2C clock frequency (Hz)"
            range 100000 400000
            default 400000
            help
                Standard mode: 100000, Fast mode: 400000.

        config APP_I2C_TIMEOUT_MS
            int "I2C transaction timeout (ms)"
            range 100 1000
            default 100
            help
                I2C timeout.
    endmenu

    menu "BME280"
        config APP_BME280_I2C_ADDR
            hex "BME280 I2C address"
            default 0x76
            help
                0x76 or 0x77 depending on SDO pin wiring.

        config APP_BME280_READ_INTERVAL_MS
            int "BME280 read interval (ms)"
            range 60000 300000
            default 60000
            help
                How often to poll temperature/humidity/pressure.
    endmenu

    menu "VCNL4010"
        config APP_VCNL4010_INT_GPIO
            int "VCNL4010 interrupt GPIO"
            range 0 27
            default 0
            help
                GPIO wired to the VCNL4010 INT pin, used to wake the display.
                NOTE: verify this pin is not a boot-mode strapping pin on
                your specific board before relying on the default of 0.

        config APP_VCNL4010_PROX_THRESHOLD
            int "Proximity trigger threshold"
            range 2300 65535 
            default 2500
            help
                Raw proximity count above which the interrupt fires.
    endmenu

    menu "SSD1306 Display"
        config APP_SSD1306_I2C_ADDR
            hex "SSD1306 I2C address"
            default 0x3C
            help
                0x3C or 0x3D depending on SA0/ADDR pin wiring.
    endmenu

    menu "Zigbee Config"
        config APP_ZB_MANUFACTURER_NAME
            string "Zigbee manufacturer name"
            default "DIY"

        config APP_ZB_MODEL_IDENTIFIER
            string "Zigbee model identifier"
            default "ESP32H2-EnvMon"

        config APP_ZB_PRIMARY_CHANNEL_MASK
            hex "Primary channel mask"
            default 0x02108800
            help
                Bitmask of primary channels to scan (0x02108800 = channels 11, 15, 20, 25).

        config APP_ZB_SECONDARY_CHANNEL_MASK
            hex "Secondary channel mask"
            default 0x05EF7000
            help
                Bitmask of secondary channels (remaining channels 11-26).
    endmenu

endmenu
```

## firmware/sdkconfig.defaults
```kconfig
#
# Partition Table
#
CONFIG_PARTITION_TABLE_CUSTOM=y
CONFIG_PARTITION_TABLE_CUSTOM_FILENAME="partitions.csv"
# end of Partition Table

#
# Zigbee
#
CONFIG_ZB_ENABLED=y
CONFIG_ZB_RADIO_NATIVE=y
CONFIG_ZB_ZED=y
# end of Zigbee

#
# light sleep
#
CONFIG_PM_ENABLE=y
CONFIG_ESP_SLEEP_POWER_DOWN_FLASH=y
CONFIG_FREERTOS_USE_TICKLESS_IDLE=y
CONFIG_IEEE802154_SLEEP_ENABLE=y
# end of light sleep
```
